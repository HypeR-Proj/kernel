## Kconfig
```kconfig
# SPDX-FileCopyrightText: 2026 roolrz
# SPDX-License-Identifier: Apache-2.0

mainmenu "HypeR Kernel Configuration"

menu "Architecture"

choice ARCH
    prompt "Target architecture"
    default ARCH_AARCH64

config ARCH_AARCH64
    bool "AArch64 architecture"

config ARCH_RISCV64
    bool "RISC-V 64-bit architecture"

config ARCH_X86_64
    bool "x86-64 architecture"

endchoice

config ARM64_VA_BITS
    int "AArch64 host virtual-address width"
    range 42 48
    default 48
    depends on ARCH_AARCH64

config ARM64_PA_BITS
    int "Maximum AArch64 physical-address width"
    range 32 48
    default 48
    depends on ARCH_AARCH64
    help
        Supported physical-address widths are 32, 36, 40, 42, 44 and 48 bits.
        Other integers in the displayed range are rejected by validation.

config ARM64_IPA_BITS
    int "AArch64 guest intermediate-physical-address width"
    range 32 39
    default 39
    depends on ARCH_AARCH64

config RANDOMIZE_BASE
    bool "Randomize the kernel virtual address"
    default y
    depends on ARCH_AARCH64
    help
        Randomize the kernel virtual address at boot. Currently implemented
        only on AArch64; RISC-V and x86-64 use fixed kernel virtual addresses
        and cannot enable this option.

endmenu

menu "Optional kernel functionality"

config FEATURE_RTC
    bool "Hardware realtime clocks (rtc)"
    default y
    help
        Discover firmware-initialized realtime clocks. Disabling this leaves
        monotonic time available and realtime uncalibrated.

config FEATURE_RUNTIME_SYMBOLS
    bool "Runtime symbol tables (runtime-symbols)"
    default y
    help
        Embed symbols for crash reports and diagnostic call chains. Disabling
        this omits the table and its build passes, without stripping ELF debug
        information.

config FEATURE_CRASH_CONSOLE
    bool "Interactive fatal monitor (crash-console)"
    default y
    depends on ARCH_AARCH64
    help
        Enable the allocation-free interactive monitor after a fatal error.
        Fatal reporting and crash coordination remain when disabled.

config FEATURE_HEAP_PROFILING
    bool "Detailed heap accounting (heap-profiling)"
    default n
    help
        Track occupancy and allocation traffic by size class. Basic memory
        ownership accounting remains available without these extra counters.

config FEATURE_PMU_PROFILING
    bool "PMUv3 sampling (pmu-profiling)"
    default n
    depends on ARCH_AARCH64
    help
        Compile the PMUv3 sampler and privileged perf recording interface.
        Compiling support does not start a recording.

config FEATURE_KERNEL_TRACE
    bool "Static tracepoints (kernel-trace)"
    default n
    help
        Compile tracepoint metadata and bounded per-CPU recording buffers.
        Recording is controlled separately at runtime; disabling support also
        removes trace call sites and field evaluation.

endmenu

menu "Kernel test instrumentation"

config FEATURE_KERNEL_TEST
    bool "Permit kernel test instrumentation (kernel-test)"
    default n
    help
        Explicit permission to compile test instrumentation. This alone does
        not run tests. Each test also needs its individual selector below.
        Leave disabled for production images.

config FEATURE_KERNEL_SELF_TEST
    bool "Boot kernel self-tests instead of Native init (kernel-self-test)"
    default n
    depends on FEATURE_KERNEL_TEST

config FEATURE_KERNEL_SMMUV3_TEST
    bool "SMMUv3 fault fixture (kernel-smmuv3-test)"
    default n
    depends on FEATURE_KERNEL_TEST && FEATURE_KERNEL_SELF_TEST && ARCH_AARCH64
    help
        Requires the boot-time self-test suite and a suitable QEMU SMMUv3
        fixture. This is not the production Native startup path.

config FEATURE_KERNEL_VGIC_TC_TEST
    bool "Force virtual GIC compatibility trapping (kernel-vgic-tc-test)"
    default n
    depends on FEATURE_KERNEL_TEST && ARCH_AARCH64

config FEATURE_IO_DMA_REVOKE_TEST
    bool "Production-domain DMA revocation fixture (io-dma-revoke-test)"
    default n
    depends on FEATURE_KERNEL_TEST && ARCH_AARCH64
    help
        Compile deliberate DMA mapping revocation and its private test mailbox.
        Enable only for the dedicated isolation acceptance workload.

config FEATURE_KERNEL_STACK_AUDIT
    bool "Retired-thread stack sampling (kernel-stack-audit)"
    default n
    depends on FEATURE_KERNEL_TEST
    help
        Retain stack high-water samples for acceptance workloads. This adds
        instrumentation to thread retirement and stack diagnostics.

endmenu

menu "CPU topology and scheduling"

config MAX_CPUS
    int "Maximum supported CPU count"
    range 1 256
    default 8

config SCHED_FAIR_QUANTUM_MS
    int "Fair scheduler maximum competing turn in milliseconds"
    range 1 1000
    default 10

choice SCHED_FAIR_BACKEND
    prompt "Fair scheduling algorithm"
    default SCHED_FAIR_STRIDE
config SCHED_FAIR_STRIDE
    bool "Weighted stride"
config SCHED_FAIR_RR
    bool "Round robin"
endchoice

config SCHED_PERIOD_MS
    int "Common scheduling arbitration and budget period (ms)"
    range 2 1000
    default 20

config SCHED_PRIORITY_ALLOWANCE_MS
    int "Priority services allowance per CPU and period (ms)"
    range 1 1000
    default 4

config SCHED_PROTECTED_MIN_MS
    int "Minimum competing ordinary work opportunity (ms)"
    range 1 1000
    default 2

config SCHED_VCPU_BUDGET_MS
    int "Default vCPU budget per period (ms)"
    range 1 1000
    default 14

config SCHED_VCPU_BURST_MS
    int "Maximum uninterrupted vCPU turn with competing work (ms)"
    range 1 1000
    default 10

choice SCHED_GUEST_PREFERENCE
    prompt "Ordinary guest versus ordinary Native work"
    default SCHED_PREFER_GUEST
config SCHED_PREFER_GUEST
    bool "Prefer guest budget, preserve Native minimum"
config SCHED_PREFER_NATIVE
    bool "Prefer Native work, preserve competing guest budget"
endchoice

endmenu

menu "Stack sizes"

config KERNEL_STACK_SIZE_KB
    int "Kernel thread stack size in KiB"
    range 16 256
    default 32
    help
        Select a power of two: 16, 32, 64, 128 or 256 KiB. Physical pages
        are allocated per live Thread, not for every scheduler slot.

config IRQ_STACK_SIZE_KB
    int "Per-CPU IRQ stack size in KiB"
    range 16 128
    default 32
    help
        Select a power of two: 16, 32, 64 or 128 KiB per CPU.

config EMERGENCY_STACK_SIZE_KB
    int "Per-CPU emergency stack size in KiB"
    range 16 128
    default 32
    help
        Select a power of two: 16, 32, 64 or 128 KiB per CPU.

endmenu

menu "Kernel logging"

config LOG_COMPILE_LEVEL
    int "Maximum kernel log severity compiled into the image"
    range 0 7
    default 6

config CONSOLE_LOGLEVEL_DEFAULT
    int "Default runtime console log severity"
    range 0 7
    default 6

config LOG_BUF_SHIFT
    int "Kernel log ring size as a power of two"
    range 12 20
    default 16

config LOG_LINE_MAX
    int "Maximum formatted kernel log record length"
    range 128 2048
    default 512

endmenu
```

## configs/qemu_aarch64_defconfig
```kconfig
# SPDX-FileCopyrightText: 2026 roolrz
# SPDX-License-Identifier: Apache-2.0

CONFIG_ARCH_AARCH64=y
CONFIG_ARM64_VA_BITS=48
CONFIG_ARM64_PA_BITS=48
CONFIG_ARM64_IPA_BITS=39
CONFIG_KERNEL_STACK_SIZE_KB=32
```

## configs/qemu_riscv64_defconfig
```kconfig
# SPDX-FileCopyrightText: 2026 roolrz
# SPDX-License-Identifier: Apache-2.0

CONFIG_ARCH_RISCV64=y
CONFIG_KERNEL_STACK_SIZE_KB=32
```

## configs/qemu_x86_64_defconfig
```kconfig
# SPDX-FileCopyrightText: 2026 roolrz
# SPDX-License-Identifier: Apache-2.0

CONFIG_ARCH_X86_64=y
CONFIG_KERNEL_STACK_SIZE_KB=32
```
